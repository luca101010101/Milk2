/*
 * Copyright (c) 2022 The ZMK Contributors
 *
 * SPDX-License-Identifier: MIT
 */

#include <behaviors.dtsi>
#include <dt-bindings/zmk/bt.h>
#include <dt-bindings/zmk/keys.h>

/ {
    keymap {
        compatible = "zmk,keymap";

        default_layer {
            bindings = <
&kp C_VOLUME_DOWN  &lt 1 C_VOLUME_UP
            >;
        };

        layer_1 {
            bindings = <
&bt BT_CLR_ALL  &mo 1
            >;
        };
    };
};
